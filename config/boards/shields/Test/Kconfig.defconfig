## config/boards/shields/Test/Kconfig.defconfig
```kconfig
if SHIELD_CYGNUS_R

config ZMK_KEYBOARD_NAME
    default "Cygnus-M_R"

config ZMK_SPLIT
    default y

config ZMK_SPLIT_ROLE_CENTRAL
    default y

endif

if SHIELD_CYGNUS_L

config ZMK_KEYBOARD_NAME
    default "Cygnus-M_L"

config ZMK_SPLIT
    default y

endif
```

## config/boards/shields/Test/Kconfig.shield
```kconfig
config SHIELD_Cygnus_R
    def_bool $(shields_list_contains,Cygnus_R)

config SHIELD_Cygnus_L
    def_bool $(shields_list_contains,Cygnus_L)
```
